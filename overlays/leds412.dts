/dts-v1/;

/plugin/;

/ {
	compatible = "digilent,zynq-artyz7", "xlnx,zynq-7000";
	part-number = "Arty Physical I/O";
	version = "1.0";
	fragment@0 {
		target-path = "/fpga_full";
		#address-cells = <1>;
		#size-cells = <1>;
		__overlay__{
			#address-cells = <1>;
			#size-cells = <1>;
			
			firmware-name = "dtree_wrapper.bin";
			
		};
	};
	
	fragment@1 {
		target-path = "/";
		#address-cells = <1>;
		#size-cells = <1>;
		__overlay__{
			#address-cells = <1>;
			#size-cells = <1>;
				axi_gpio_LED: gpio@41200000 {
					#gpio-cells = <2>;
					compatible = "xlnx,xps-gpio-1.00.a";
					gpio-controller ;
					reg = <0x41200000 0x10000>;
					xlnx,all-inputs = <0x0>;
					xlnx,all-inputs-2 = <0x0>;
					xlnx,all-outputs = <0x0>;
					xlnx,all-outputs-2 = <0x0>;
					xlnx,dout-default = <0x00000000>;
					xlnx,dout-default-2 = <0x00000000>;
					xlnx,gpio-width = <0x4>;
					xlnx,gpio2-width = <0x6>;
					xlnx,interrupt-present = <0x0>;
					xlnx,is-dual = <0x1>;
					xlnx,tri-default = <0xFFFFFFFF>;
					xlnx,tri-default-2 = <0xFFFFFFFF>;
				};
				
				axi_gpio_btns: gpio@41210000 {
					#gpio-cells = <2>;
					#interrupt-cells = <2>;
					compatible = "xlnx,xps-gpio-1.00.a";
					gpio-controller ;
					interrupt-controller ;
					reg = <0x41210000 0x10000>;
					xlnx,all-inputs = <0x1>;
					xlnx,all-inputs-2 = <0x1>;
					xlnx,all-outputs = <0x0>;
					xlnx,all-outputs-2 = <0x0>;
					xlnx,dout-default = <0x00000000>;
					xlnx,dout-default-2 = <0x00000000>;
					xlnx,gpio-width = <0x4>;
					xlnx,gpio2-width = <0x2>;
					xlnx,interrupt-present = <0x1>;
					xlnx,is-dual = <0x1>;
					xlnx,tri-default = <0xFFFFFFFF>;
					xlnx,tri-default-2 = <0xFFFFFFFF>;
				};
			};
	
	};
};
