/dts-v1/;
/plugin/;

/{
	compatible = "digilent,zynq-artyz7", "xlnx,zynq-7000";
	part-number = "Arty Z7 I2C and SPI";
	version = "1.0";

	fragment@0 {
		target-path = "/";
		#address-cells = <0x00000001>;                                                                          
        #size-cells = <0x00000001>; 
		__overlay__{	
			amba_pl: amba_pl {
				#address-cells = <1>;
				#size-cells = <1>;
				compatible = "simple-bus";
				ranges;
				interrupt-parent = <0x4>;
			};
		};
	};
};